## project/apps/he_app/tests/testcase.yaml
```yaml
tests:
  project.he_app:
    platform_allow:
      - native_sim
    integration_platforms:
      - native_sim
      
    tags: [he_app]
    harness: ztest
```

## project/apps/hp_app/tests/testcase.yaml
```yaml
tests:
  project.hp_app:
    platform_allow:
      - native_sim
    integration_platforms:
      - native_sim

    tags: [hp_app]
    harness: ztest
```

## project/drivers/eth/Kconfig
```kconfig
menuconfig ETH_ALIF
    bool "Enable Alif native Ethernet driver"
    depends on DT_HAS_ZEPHYR_ETH_ALIF_ENABLED
    select NET_L2_ETHERNET
    select NETWORKING
    help
      Enable the driver for the Alif E7 Ethernet controller.

if ETH_ALIF

config ETH_ALIF_RX_DELAY_US
    int "Delay in microseconds after packet reception"
    default 1
    range 0 1000
    help
      Add a delay after receiving each packet to help with ARP timing issues.
      Workaround for Alif E7 platform where ARP packets are not properly
      received without this delay. Default is 20 microseconds.

config ETH_ALIF_RX_DESC_COUNT
    int "Number of RX DMA descriptors / buffers"
    default 24
    range 4 64
    help
      Size of the receive DMA descriptor ring (one 1536-byte buffer each, in
      the ETH_DMA region). Larger rings absorb RX bursts while the CPU drains
      them, reducing MAC-level drops (Rx Buffer Unavailable) at high rates.
      Keep RX+TX buffers within the ETH_DMA memory region.

config ETH_ALIF_TX_DESC_COUNT
    int "Number of TX DMA descriptors / buffers"
    default 8
    range 4 64
    help
      Size of the transmit DMA descriptor ring (one 1536-byte buffer each).

config ETH_ALIF_ZEROCOPY_RX
    bool "Zero-copy RX (hand DMA buffers to the net stack without memcpy)"
    default n
    help
      Experimental. Instead of copying each received frame into a freshly
      allocated net_pkt buffer (net_pkt_write), wrap the DMA buffer in an
      external-data net_buf and recycle it through a free-list once the stack
      frees it. Removes one per-packet 1.5 KB memcpy from the RX path. Needs
      RX spare buffers in the ETH_DMA region: RX buffers = 2 x RX_DESC_COUNT,
      so keep RX_DESC_COUNT small enough that 2*RX + TX buffers fit ETH_DMA.

config ETH_ALIF_ZEROCOPY_TX
    bool "Zero-copy TX (DMA straight from the net_pkt, no memcpy)"
    default n
    help
      Experimental. When a net_pkt to transmit is a single contiguous fragment
      (set CONFIG_NET_BUF_DATA_SIZE >= frame size, e.g. 1536), point the TX DMA
      descriptor straight at the fragment data instead of copying it into a
      driver TX buffer (net_pkt_read). The net_pkt is referenced until the DMA
      completes and unref'd on TX-complete. Multi-fragment packets fall back to
      the copy path.

endif # ETH_ALIF
  
```

## project/drivers/sensor/ma780/Kconfig
```kconfig
# Confidential - Copyright PA.COTTE: All rights reserved

menuconfig MA780
	bool "MA780 sensor"
	default y
	depends on DT_HAS_MPS_MA780_ENABLED
	select SPI
	help
	  Enable driver for MA780 Low-Power Angle Sensor.

if MA780

choice
	prompt "Trigger mode"
	default MA780_TRIGGER_NONE
	help
	  Specify the type of triggering used by the driver.

config MA780_TRIGGER_NONE
	bool "No trigger"

config MA780_TRIGGER_GLOBAL_THREAD
	bool "Use global thread"
	depends on GPIO
	select MA780_TRIGGER

config MA780_TRIGGER_OWN_THREAD
	bool "Use own thread"
	depends on GPIO
	select MA780_TRIGGER

endchoice

config MA780_TRIGGER
	bool

config MA780_THREAD_PRIORITY
	int "Thread priority"
	depends on MA780_TRIGGER_OWN_THREAD && MA780_TRIGGER
	default 10
	help
	  Priority of thread used by the driver to handle interrupts.

config MA780_THREAD_STACK_SIZE
	int "Thread stack size"
	depends on MA780_TRIGGER_OWN_THREAD && MA780_TRIGGER
	default 1024
	help
	  Stack size of thread used by the driver to handle interrupts.

endif # MA780
```

## project/dts/bindings/sensor/mps,ma780.yaml
```yaml
# Confidential - Copyright PA.COTTE: All rights reserved

description: MA780 Low-Power Angle Sensor with Integrated Wake-Up Angle Detection

compatible: "mps,ma780"

include: [sensor-device.yaml, spi-device.yaml]

properties:
  int-gpios:
    required: false
    type: phandle-array
    description: |
      The INT signal defaults to active high as produced by the
      sensor.  The property value should ensure the flags properly
      describe the signal that is presented to the driver.

  wakeup-mode:
    required: false
    type: boolean
    description: |
      This mode is intended for extremely low power consumption,
      checking for motion only about six times a second.

  autosleep:
    required: false
    type: boolean
    description: |
      Enter Wake-Up mode when inactivity is detected,
      reenter Measurement mode when activity is detected.
      Only applies for Linked and Loop mode, ignored otherwise.
```

## project/dts/bindings/zephyr,eth-alif.yaml
```yaml
description: Native Alif E7 Ethernet Controller

compatible: "zephyr,eth-alif"

include:
  - ethernet-controller.yaml
  - pinctrl-device.yaml

properties:
  reg:
    required: true

  mac-address:
    type: uint8-array
    required: true
```

## project/model/west.yml
```yaml
manifest:

  projects:
    - name: edge-impulse-sdk-zephyr
      description: Edge Impulse SDK for Zephyr
      path: modules/edge-impulse-sdk-zephyr
      revision: v1.80.0
      url: https://github.com/edgeimpulse/edge-impulse-sdk-zephyr
```

## project/west.yml
```yaml
manifest:

  remotes:
    - name: alif
      url-base: https://github.com/alifsemi
    - name: armmbed
      url-base: https://github.com/ARMmbed
    - name: pacotte
      url-base: https://github.com/pa-cotte

  projects:
    - name: zephyr
      remote: alif
      repo-path: zephyr_alif
      revision: v2.3.0
      import:
        name-allowlist:
          - hal_alif
          - hal_ethos_u
          - hal_infineon
          - segger
          - liblc3
          - mbedtls
          - littlefs
          - fatfs
          - hal_nordic
          - tinycrypt
          - open-amp
          - libmetal

    - name: mcuboot_alif
      remote: alif
      repo-path: mcuboot_alif
      path: bootloader/mcuboot
      revision: zas-2.x

    - name: cmsis_alif
      remote: alif
      revision: 85f6b92af0f6ac72594d391f895c45cc30847e41
      path: modules/hal/cmsis
      groups:
         - hal
       
  self:
    path: alif
    west-commands: scripts/west-commands.yml
```
