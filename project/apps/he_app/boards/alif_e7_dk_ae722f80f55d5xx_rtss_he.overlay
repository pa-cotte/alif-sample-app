/*
 * USB CDC-ECM overlay for the Alif E7 DK (RTSS-HE):
 *  - enable the DWC3 USB device controller and gate its PHY power on,
 *  - enable NON_SECURE0, where the USB endpoint buffers must live for the
 *    controller to reach them as a bus master,
 *  - declare the CDC-ECM Ethernet interface.
 */

#include <dt-bindings/misc/alif_aipm_common.h>

&aipm_run_default {
	phy-pwr-gating = <ALIF_PHY_GATE_USB_MASK>;
};

&ns {
	status = "okay";
};

zephyr_udc0: &usb {
	status = "okay";

	cdc_ecm_eth0: cdc_ecm_eth0 {
		compatible = "zephyr,cdc-ecm-ethernet";
		local-mac-address = [02 00 5E 00 53 00]; /* device side */
		remote-mac-address = "02005E005301";     /* host side, must differ */
	};
};
